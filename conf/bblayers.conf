## conf/bblayers.conf
```bitbake
# LAYER_CONF_VERSION is increased each time build/conf/bblayers.conf
# changes incompatibly
LCONF_VERSION = "7"

BBPATH = "${TOPDIR}:${TOPDIR}/layers/openembedded-core:${TOPDIR}/layers/meta-arm"
#BBPATH += "${TOPDIR}/openembedded/openembedded-core"
BBFILES ?= ""

BBLAYERS ?= " \
  ${TOPDIR}/layers/openembedded-core/meta \
  ${TOPDIR}/layers/meta-arm/meta-arm \
  ${TOPDIR}/layers/meta-arm/meta-arm-bsp \
  ${TOPDIR}/layers/meta-arm/meta-arm-systemready \
  ${TOPDIR}/layers/meta-arm/meta-arm-toolchain \
  ${TOPDIR}/layers/meta-ti/meta-ti-bsp \
  ${TOPDIR}/layers/meta-ti/meta-ti-extras \
  ${TOPDIR}/layers/meta-beagleplay \
  "
```

## layers/meta-beagleplay/conf/layer.conf
```bitbake
# We have a conf and classes directory, add to BBPATH
BBPATH .= ":${LAYERDIR}"

# We have recipes-* directories, add to BBFILES
BBFILES += "${LAYERDIR}/recipes-*/*/*.bb ${LAYERDIR}/recipes-*/*/*.bbappend"

BBFILE_COLLECTIONS += "beagleplay"
BBFILE_PATTERN_beagleplay = "^${LAYERDIR}/"
BBFILE_PRIORITY_beagleplay = "1"

# This should only be incremented on significant changes that will
# cause compatibility issues with other layers
LAYERVERSION_beagleplay = "1"

LAYERDEPENDS_beagleplay = "core"

LAYERSERIES_COMPAT_beagleplay = "scarthgap"
```

## layers/meta-beagleplay/conf/machine/beagleplay-dev.conf
```bitbake
require conf/machine//include/beagle.inc
require conf/machine/include/k3.inc

SERIAL_CONSOLES = "115200;ttyS2"

SOC_FAMILY:append = ":am62xx"

TFA_BOARD = "lite"
TFA_K3_SYSTEM_SUSPEND = "1"

OPTEEMACHINE = "k3-am62x"

UBOOT_MACHINE = "am62x_evm_a53_defconfig"

# UBOOT_CONFIG_FRAGMENTS holds the list of u-boot config fragments which has to be build
# along with the base defconfig mentioned in UBOOT_MACHINE. Refer u-boot-mergeconfig.inc
# under meta-ti-bsp/recipes-bsp/u-boot/ for more details.
UBOOT_CONFIG_FRAGMENTS = "am625_beagleplay_a53.config"

PREFERRED_PROVIDER_virtual/kernel = "linux-beagleplay-dev"
PREFERRED_PROVIDER_virtual/bootloader = "u-boot-bb.org"
PREFERRED_PROVIDER_u-boot = "u-boot-bb.org"

KERNEL_DEVICETREE_PREFIX = " \
    ti/k3-am625 \
    ti/k3-am62x-sk \
"
KERNEL_DEVICETREE = "ti/k3-am625-beagleplay.dtb"
```
