&main_spi2 {
    testspi@0 {
        compatible = "sharp,ls013b7dh03";
        status = "okay";
        spi-cs-high = <1>;
        spi-max-frequency = <1000000>;
        reg = <0>;
        com-gpios = <&main_gpio1 11 GPIO_ACTIVE_HIGH>;
    };
};   
